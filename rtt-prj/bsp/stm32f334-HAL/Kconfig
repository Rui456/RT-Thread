## rtt-prj/bsp/stm32f334-HAL/Kconfig
```kconfig
mainmenu "RT-Thread Configuration"

config $BSP_DIR
    string
    option env="BSP_ROOT"
    default "."

config $RTT_DIR
    string
    option env="RTT_ROOT"
    default "../.."

config $PKGS_DIR
    string
    option env="PKGS_ROOT"
    default "packages"

source "$RTT_DIR/Kconfig"
source "$PKGS_DIR/Kconfig"


choice
    prompt "Device type"
    default STM32F334C6
    config SOC_STM32F334C6
        bool "STM32F334C6"
    config SOC_STM32F334C8
        bool "STM32F334C8"

endchoice
config RT_USING_HSI
    bool "Using HSI as clock source"
    default n
config RT_HSE_VALUE
    int "HSE Value"
    default 8000000
    depends on !RT_USING_HSI
config RT_HSE_HCLK
    int "System Clock Value"
    default 72000000
config RT_USING_UART1
    bool "Using UART1"
    default y    

config RT_USING_UART2
    bool "Using UART2"
    default n    

config RT_USING_UART6
    bool "Using UART6"
    default n   
	
if RT_USING_SPI

config RT_USING_SPI1
    bool "Using SPI1"
    default y 

config RT_USING_SPI2
    bool "Using SPI2"
    default n  

config RT_USING_SPI3
    bool "Using SPI3"
    default n 

endif

if RT_USING_W25QXX
config RT_W25QXX_CS_PIN
    int "W25QXX CS Pin index"
    default 0
config RT_W25QXX_SPI_BUS_NAME
    string "W25QXX Spi bus name"
    default "spi1"
endif

if RT_USING_USB_DEVICE
    config USB_VENDOR_ID
        hex "USB VID"
        default 0x0483
    config USB_PRODUCT_ID
        hex "USB PID"
        default 0x5750
endif

if RT_USING_USB_HOST
menu "USB Host Config"
    config USBH_USING_CONTROLLABLE_POWER
        bool "using a gpio control usb power"
        default y
    if USBH_USING_CONTROLLABLE_POWER
        config USBH_POWER_PIN
            int "power control pin"
            default 15
        config USBH_CURRENT_PIN
            int "current check pin"
            default 86
    endif
    config USBH_USING_VBUS
        bool "using vbus check pin"
        default n
endmenu
endif



    
    
```
